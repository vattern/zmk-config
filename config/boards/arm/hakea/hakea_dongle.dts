/*
 * Copyright (c) 2021 Thys de Wet (vattern)
 *
 * SPDX-License-Identifier: MIT
 */

/dts-v1/;
#include <nordic/nrf52840_qiaa.dtsi>
#include <dt-bindings/zmk/matrix_transform.h>
#include "hakea.dtsi"
/ {
    kscan0: kscan {
        col-gpios
            = <&gpio0 23  GPIO_ACTIVE_HIGH>
            , <&gpio1 2   GPIO_ACTIVE_HIGH>
            , <&gpio0 9   GPIO_ACTIVE_HIGH>
            , <&gpio1 6   GPIO_ACTIVE_HIGH>
            , <&gpio1 4   GPIO_ACTIVE_HIGH>
            , <&gpio0 10  GPIO_ACTIVE_HIGH>
            ;
        };
    };

  
    &left_encoder {
        status = "okay";
    };

