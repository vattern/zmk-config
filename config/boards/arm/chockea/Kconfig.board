## config/boards/arm/chockea/Kconfig.board
```kconfig
# Copyright (c) 2020-2021 Thys de Wet (vattern)
# SPDX-License-Identifier: MIT



config BOARD_CHOCKEA
	bool "chockea"
	depends on SOC_NRF52840_QIAA

config BOARD_CHOCKEA_LEFT
	bool "chockea"
	depends on SOC_NRF52840_QIAA

config BOARD_CHOCKEA_RIGHT
	bool "chockea"
	depends on SOC_NRF52840_QIAA
```

## config/boards/arm/chockea/chockea_right_defconfig
```kconfig
# SPDX-License-Identifier: MIT
CONFIG_BUILD_OUTPUT_UF2=y
CONFIG_SOC_SERIES_NRF52X=y
CONFIG_SOC_NRF52840_QIAA=y
CONFIG_BOARD_CHOCKEA_RIGHT=y

CONFIG_ZMK_USB_LOGGING=y


# Enable MPU
CONFIG_ARM_MPU=y

# enable GPIO
CONFIG_GPIO=y

CONFIG_USE_DT_CODE_PARTITION=y

# enable pwm
CONFIG_PWM=n
CONFIG_PWM_NRFX=n

CONFIG_MPU_ALLOW_FLASH_WRITE=y
CONFIG_NVS=y
CONFIG_SETTINGS_NVS=y
CONFIG_FLASH=y
CONFIG_FLASH_PAGE_LAYOUT=y
CONFIG_FLASH_MAP=y

# set TX power level
CONFIG_BT_CTLR_TX_PWR_PLUS_8=y

# Enable Underglow
CONFIG_ZMK_RGB_UNDERGLOW=n
CONFIG_WS2812_STRIP=n
CONFIG_ZMK_RGB_UNDERGLOW_EXT_POWER=n
CONFIG_ZMK_RGB_UNDERGLOW_ON_START=n

# Enable the rotary encoder
CONFIG_EC11=n
CONFIG_EC11_TRIGGER_GLOBAL_THREAD=n

# Enable sleep
CONFIG_ZMK_SLEEP=n
# CONFIG_ZMK_IDLE_SLEEP_TIMEOUT=120000

# OLED config
#CONFIG_ZMK_DISPLAY=n
#CONFIG_I2C=n
#CONFIG_SSD1306=y
#CONFIG_SSD1306_REVERSE_MODE=y
#CONFIG_LVGL_HOR_RES_MAX=128
#CONFIG_LVGL_VER_RES_MAX=32
#CONFIG_LVGL_VDB_SIZE=64
#CONFIG_LVGL_DPI=148
#CONFIG_LVGL_BITS_PER_PIXEL=1
#CONFIG_LVGL_COLOR_DEPTH_1=y
```

## config/boards/arm/hakea/Kconfig.board
```kconfig
# Copyright (c) 2020-2021 Thys de Wet (vattern)
# SPDX-License-Identifier: MIT



config BOARD_HAKEA
	bool "nurgle"
	depends on SOC_NRF52840_QIAA

config BOARD_HAKEA_LEFT
	bool "nurgle"
	depends on SOC_NRF52840_QIAA

config BOARD_HAKEA_RIGHT
	bool "nurgle"
	depends on SOC_NRF52840_QIAA

config BOARD_HAKEA_DONGLE
	bool "nurgle"
	depends on SOC_NRF52840_QIAA
```

## config/boards/arm/hakea/Kconfig.defconfig
```kconfig
# Copyright (c) 2020-2021 Thys de Wet (vattern)
# SPDX-License-Identifier: MIT

if BOARD_HAKEA_LEFT

config ZMK_SPLIT_ROLE_CENTRAL
	default y

config ZMK_KEYBOARD_NAME
	default "hakea"

config ZMK_USB
	default y

endif # BOARD_v_LEFT


if BOARD_HAKEA_LEFT || BOARD_HAKEA_RIGHT

config ZMK_SPLIT
	default y

if USB

config USB_NRFX
	default y

config USB_DEVICE_STACK
	default y

endif # USB

config BT_CTLR
	default BT

config ZMK_BLE
	default y



config ZMK_BATTERY_VOLTAGE_DIVIDER
	default y

config ZMK_DISPLAY
        select LV_USE_CONT
        select LV_USE_LABEL
        select LV_USE_IMG
        select LV_FONT_MONTSERRAT_26

choice ZMK_DISPLAY_STATUS_SCREEN
        default ZMK_DISPLAY_STATUS_SCREEN_CUSTOM

endchoice

if ZMK_DISPLAY

config I2C
	default y

config SSD1306
	default y



endif # ZMK_DISPLAY

if LVGL

config LV_Z_VDB_SIZE
	default 64

config LV_DPI_DEF
	default 148

config LV_Z_BITS_PER_PIXEL
	default 1

choice LV_COLOR_DEPTH
	default LV_COLOR_DEPTH_1
endchoice

endif # LVGL


endif # BOARD_HAKEA_LEFT || BOARD_HAKEA_RIGHT
```

## config/boards/arm/scylla/Kconfig.board
```kconfig
# Copyright (c) 2020-2021 Thys de Wet (vattern)
# SPDX-License-Identifier: MIT



config BOARD_SCYLLA
	bool "scylla"
	depends on SOC_NRF52840_QIAA

config BOARD_SCYLLA_LEFT
	bool "scylla"
	depends on SOC_NRF52840_QIAA

config BOARD_SCYLLA_RIGHT
	bool "scylla"
	depends on SOC_NRF52840_QIAA
```

## config/west.yml
```yaml
manifest:
  remotes:
    - name: zmkfirmware
      url-base: https://github.com/zmkfirmware
    - name: pete
      url-base: https://github.com/petejohanson
  projects:
    - name: zmk
      remote: pete
      revision: main
      import: app/west.yml
  self:
    path: config
```
